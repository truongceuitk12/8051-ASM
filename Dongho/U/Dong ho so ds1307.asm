	GIO EQU 7FH ;GIO
	PHUT EQU 7EH ;PHUT
	GIAY EQU 7DH ;GIAY
		
	SCL BIT P3.6 ;CHAN SCL NOI DEN ROM
	SDA BIT P3.7 ;CHAN SDA NOI DEN ROM					 

	W1307 EQU 0D0H ;HANG SO VIET VAO DS1307
	R1307 EQU 0D1H ;HANG S0 DOC	TU DS1307

	CHON BIT P2.0 ; NUT NHAN GHON GIA TRI CAN CHINH
	TANG  BIT P2.1 ; NUT NHAN TANG GIA TRI
	GIAM BIT P2.2 ; NUT NHAN GIAM GIA TRI
	//CHON_BT BIT P2.3 ; NUT CHON CHINH BAO THUC
	//TAT_BT BIT P2.4 ; NUT NHAN TAT BAO THUC

	//COI BIT P3.0 ; COI BAO THUC

	PN BIT 20H.0 ; BIT NHO CO PHIM NHAN
	BITCT BIT 20H.1; BIT SU DUNG CHO CHUONG TRINH TAO CHOP TAT KHI CHINH
	
	CHOPTAT EQU R4 ; THOI GIAN CHO MOI LAN CHOP TAT KHI CHINH
	CHE_DO EQU R5 ; CHE DO HIEN THI VA CHIN THOI GIAN
	;CHE_DO = 0 - BINH THUONG
	;CHE_DO = 1 - CHON GIAY
	;CHE_DO = 2 - CHON PHUT
	;CHE_DO = 3 - CHON GIO
	;CHE_DO = 4 - CHON NGAY
	;CHE_DO = 5 - CHON THANG
	;CHE_DO = 6 - CHON NAM
	CHUYEN EQU R3 ; CHE DO HIEN THI VA CHIN THOI GIAN
	TG_CHUYEN_DAT EQU 35;
	
	N_GIAY EQU R6
	TG_CHAM EQU R2 ;
	CHAM BIT 20H.2 ;
	ORG 0 ;DIEM NHAP CUA RESET
;======================================== 
MAIN: ;CHUONG TRINH CHINH
	MOV SP,#30H ; NAP VI TRI NGAN XEP BAT DAU TU 30H
	MOV CHOPTAT,#100 ; 
	MOV CHE_DO,#0
	MOV TG_CHAM,#0
	MOV CHUYEN,#0;
	CALL DS1307INIT ;KHOI DONG RTC
	CALL DOCBT
MAIN1: 
	CALL DOCTG ;DOC THOI GIAN TU RTC
	MOV A,N_GIAY
	CJNE A,GIAY,M000
	JMP M001
M000:
	MOV N_GIAY,GIAY
	SETB CHAM
	MOV TG_CHAM,#0;
;M001:
	;INC TG_CHAM
	;CJNE TG_CHAM,#2,M002
	;CLR CHAM
;M002:

	;INC CHUYEN;
	;CJNE CHUYEN,#45,M00
	;MOV CHUYEN,#0;
M00:
	MOV R7,#40
LAP:
	CJNE CHE_DO,#0,M1
	CALL HIENTHI2;
	JMP M2
M1:
	CALL HIENTHI ;HIEN THI QUET LED 7 DOAN
M2:
	CALL QUET_PHIM_NHAN ;GOI CHUONG TRINH NUT NHAN CHINH THOI GIAN
	CALL DAO_BIT_CHOP_TAT
	CALL SO_SANH
	DJNZ R7,LAP
	SJMP  MAIN1 ;LAP LAI CHUONG TRINH

;====================

;======================================== 
QUET_PHIM_NHAN: ; QUET NUT NHAN
	PUSH ACC
	JNB PN,NKN ; KIEM TRA KHONG NHAN NUT KHI PN = 0
		JB CHON,NN0 ; KIEM TRA NHAN PHIM CHON
			MOV CHOPTAT,#100 ; SO LAN QUET CHOP TAT = 100
			CLR BITCT ; TAT LED CHON KHI MOI NHAN
			CLR PN ; XOA PN = 0 ; CO PHIM NHAN
			INC CHE_DO ; TANG CHE DO
			CJNE CHE_DO,#7,TQPN ; NEU CHE DO = 7
			MOV CHE_DO,#0 ; NAP LAI CHE DO = 0
		JMP TQPN
	NN0:
		JB TANG,NN1
			MOV CHOPTAT,#100
			SETB BITCT ; HIEN THI LED CHON KHI MOI NHAN
			CLR PN
			CALL TANGTG; TANG GIA TRI DUOC CHON
			CALL NAPTG
		JMP TQPN
	NN1:
		JB GIAM,NN2
			MOV CHOPTAT,#100
			SETB BITCT
			CLR PN 
			CALL GIAMTG	
			CALL NAPTG
		JMP TQPN
	NN2:
		;JB CHON_BT,NN3
			;MOV CHOPTAT,#100
			;SETB BITCT ; HIEN THI LED CHON KHI MOI NHAN
			;CLR PN
			;MOV A,CHE_DO ; NAP A GIA TRI CHE DO
			;CJNE A,#4,$+3
			;JNC NN21 ; KHI A >= 4
			;MOV CHE_DO,#4
			;JMP NN22
		;NN21: ; 
			;INC CHE_DO
			;CJNE CHE_DO,#6,NN22
			;MOV CHE_DO,#0 
			;CALL NAPBT
		;NN22:
		;JMP TQPN
	NN3:
;	JB TAT_BT,TQPN
;	SETB COI
	JMP TQPN
NKN: ; KIEM TRA NUT KHONG NHAN
	JNB CHON,TQPN ; KHI TAT CA CAC PHIM DUOC NHA
;	JNB CHON_BT,TQPN
	JNB GIAM,TQPN
	JNB TANG,TQPN
	SETB PN	; PN = 1 ; CHO PHEP NHAN PHIM TIEPP THEO
TQPN:
	POP ACC
	RET
;=====================
;======================================== 
TANGTG:	;CHUONG TRINH CON TANG THOI GIAN THEO MO
	PUSH ACC
	SETB BITCT
//	MOV BCT,#25
;--------------------
TGIAY: ;TANG GIAY
	CJNE CHE_DO,#1,TP
	MOV A,GIAY
	ADD A,#1 ;CONG THANH GHI A THEM 1
	DA A ;HIEU CHINH THAP PHAN THANH GHI A
	CJNE A,#60H,TGIAY1
	MOV A,#00H ;GIOI HAN 00 - 59
TGIAY1:
	MOV GIAY,A
	CALL NAPTG ;NAP GIAY VUA CHINH DUOC VAO RTC
;--------------------
TP: ;TANG PHUT
	CJNE CHE_DO,#2,TG
	MOV A,PHUT
	ADD A,#1
	DA A
	CJNE A,#60H,TP1
	MOV A,#00H ;GIOI HAN 00 - 59
TP1:
	MOV PHUT,A
;--------------------
TG:
	CJNE CHE_DO,#3,TNGAY
	MOV A,GIO
	ADD A,#1
	DA A
	CJNE A,#24H,TG3
	MOV A,#00H ;GIOI HAN 00 - 23
TG3:
	MOV GIO,A
;--------------------
TNGAY:
	CJNE CHE_DO,#4,TTHANG
	MOV A,NGAY
	ADD A,#1
	DA A

	CJNE A,#32H,TNGAY1
	MOV A,#01H
TNGAY1:
	MOV NGAY,A

TTHANG:
	CJNE CHE_DO,#5,TNAM
	MOV A,THANG
	ADD A,#1
	DA A
	CJNE A,#13H,TTHANG1
	MOV A,#01H
TTHANG1:
	MOV THANG,A

TNAM:
	CJNE CHE_DO,#6,TT
	MOV A,NAM
	ADD A,#1
	DA A
	MOV NAM,A
TT:
	CJNE CHE_DO,#1,TTT
	ACALL NAPTG
TTT:
	POP ACC
	RET
;======================================== 
GIAMTG: ;GIAM THOI GIAN
	PUSH ACC
	SETB BITCT ;BAT BIT TAO CHOP TAT ( CHO HIEN THI KHI MOI NHAN NUT )
;	MOV BCT,#25 ;NAP LAI SO LAN LAP
;--------------------
GGIAY: ;GIAM GIAY
	CJNE CHE_DO,#1,GP
	MOV A,GIAY
	ADD A,#99H
	DA A
	CJNE A,#99H,GGIAY1
	MOV A,#59H
GGIAY1:
	MOV	GIAY,A
	CALL NAPTG
;--------------------
GP: ;GIAM GIO
	CJNE CHE_DO,#2,GG
	MOV A,PHUT
	ADD A,#99H
	DA A
	CJNE A,#99H,GP1
	MOV A,#59H
GP1:
	MOV	PHUT,A
;--------------------
GG: ;GIAM GIO
	CJNE CHE_DO,#3,GNGAY
	MOV A,GIO
	ADD A,#99H
	DA A
	CJNE A,#99H,TG6
	MOV A,#23H
TG6:
	MOV	GIO,A
;--------------------
;========================
TGT:
;G_PHUT_BT: ;GIAM PHUT BAO THUC
	;CJNE CHE_DO,#4,G_GIO_BT
	;MOV A,PHUT_BT
	;ADD A,#99H
	;DA A
	;CJNE A,#99H,GAP
	;MOV	A,#59H
;GAP:
	;MOV	PHUT_BT,A
;;--------------------
;G_GIO_BT: ;GIAM GIO BAO THUC
	;CJNE CHE_DO,#5,TGTG
	;MOV A,GIO_BT
	;ADD A,#99H
	;DA A
	;CJNE A,#99H,GAG
	;MOV A,#23H
;GAG:
	;MOV GIO_BT,A
;--------------------
;TGTG: ;THOAT GIAM THOI GIAN
	POP ACC
	RET
;======================================== 
DAO_BIT_CHOP_TAT:
	CJNE CHE_DO,#0,DBCT1
	JMP TDBCT
DBCT1:
	DJNZ CHOPTAT,TDBCT
	MOV CHOPTAT,#100
	CPL BITCT
TDBCT:
	RET
;======================================== 
;QUET HIEN THI LAN LUOT TUNG LED 7 DOAN
;TAI 1 THOI DIEM CHI SANG 1 LED
;==========================
HIENTHI:
	PUSH ACC
	MOV A,CHE_DO ; NAP A GIA TRI CHE DO
	CJNE A,#4,$+3
	JNC HT0; KHI A >= 4
;	JNB TAT_BT,HT0
	CALL HIEN_THI_1	; KHI A < 4 hien thi gpg 
	JMP THT0
	HT0: ; 
	CALL HIEN_THI_2 ; KHI A > 4 hien thi ntn
	THT0:
	POP ACC
	RET 
;======================================== 
HIENTHI2:
	PUSH ACC
	MOV A,CHUYEN ; NAP A GIA TRI CHE DO
	CJNE A,#TG_CHUYEN_DAT,$+3
	JNC HT20; KHI A >= 4
	CALL HIEN_THI_1	; KHI A < 4 hien thi gpg 
	JMP THT20
	HT20: ; 
	CALL HIEN_THI_2 ; KHI A > 4 hien thi ntn
	THT20:
	POP ACC
	RET 
;======================================== 
HIEN_THI_1:
	MOV A,GIO ;NAP GIO VAO A 
	SWAP A ;HOAN DOI CAO THAP THANH GHI A
	ANL A,#0FH ;XOA BO 4 BIT CAO
	CALL BCD7 ;DOI MA BCD SANG MA 7 DOAN
	MOV P0,A ;XUAT MA 7 DOAN RA PORT 0
	CJNE CHE_DO,#3,HT11
	JNB BITCT,HT12
	HT11:
	MOV P1,#11111110B ;XUAT MA QUET LET HANG CHUC GIO
	HT12:
	CALL TRELED ;TOA THOI GIAN TRE QUET LED
	MOV P1,#0FFH ;XOA PORT QUET LED
	
	MOV A,GIO
	ANL A,#0FH
	CALL BCD7
	MOV P0,A
	MOV C,CHAM
	MOV P0.7,C
	CJNE CHE_DO,#3,HT13
	JNB BITCT,HT14
	HT13:
	MOV P1,#11111101B ;XUAT MA QUET LET HANG CHUC GIO
	HT14:
	CALL TRELED
	MOV P1,#0FFH

	MOV A,PHUT
	SWAP A
	ANL A,#0FH
	CALL BCD7
	MOV P0,A
	CJNE CHE_DO,#2,HT15
	JNB BITCT,HT16
	HT15:
	MOV P1,#11111011B ;XUAT MA QUET LET HANG CHUC GIO
	HT16:
	CALL TRELED
	MOV P1,#0FFH

	MOV A,PHUT
	ANL A,#0FH
	CALL BCD7
	MOV P0,A
	MOV C,CHAM
	MOV P0.7,C
	CJNE CHE_DO,#2,HT17
	JNB BITCT,HT18
	HT17:
	MOV P1,#11110111B ;XUAT MA QUET LET HANG CHUC GIO
	HT18:
	CALL TRELED
	MOV P1,#0FFH

	MOV A,GIAY
	SWAP A
	ANL A,#0FH
	CALL BCD7
	MOV P0,A
	CJNE CHE_DO,#1,HT19
	JNB BITCT,HT110
	HT19:
	MOV P1,#11101111B ;XUAT MA QUET LET HANG CHUC GIO
	HT110:
	CALL TRELED
	MOV P1,#0FFH

	MOV A,GIAY
	ANL A,#0FH
	CALL BCD7
	MOV P0,A
	//MOV C,CHAM
	//MOV P0.7,C
	CJNE CHE_DO,#1,HT111
	JNB BITCT,HT112
	HT111:
	MOV P1,#11011111B ;XUAT MA QUET LET HANG CHUC GIO
	HT112:
	CALL TRELED
	MOV P1,#0FFH
	RET
;======================================== 
HIEN_THI_2:
	MOV A,NGAY ;NAP NGAY VAO A 
	SWAP A ;HOAN DOI CAO THAP THANH GHI A
	ANL A,#0FH ;XOA BO 4 BIT CAO
	CALL BCD7 ;DOI MA BCD SANG MA 7 DOAN
	MOV P0,A ;XUAT MA 7 DOAN RA PORT 0
	CJNE CHE_DO,#4,HT21
	JNB BITCT,HT22
	HT21:
	MOV P1,#11111110B ;XUAT MA QUET LET HANG CHUC GIO
	HT22:
	CALL TRELED ;TOA THOI GIAN TRE QUET LED
	MOV P1,#0FFH ;XOA PORT QUET LED
	
	MOV A,NGAY
	ANL A,#0FH
	CALL BCD7
	MOV P0,A
	CJNE CHE_DO,#4,HT23
	JNB BITCT,HT24
	HT23:
	MOV P1,#11111101B ;XUAT MA QUET LET HANG CHUC GIO
	HT24:
	CALL TRELED
	MOV P1,#0FFH

	MOV A,THANG
	SWAP A
	ANL A,#0FH
	CALL BCD7
	MOV P0,A
	CJNE CHE_DO,#5,HT25
	JNB BITCT,HT26
	HT25:
	MOV P1,#11111011B ;XUAT MA QUET LET HANG CHUC GIO
	HT26:
	CALL TRELED
	MOV P1,#0FFH

	MOV A,THANG
	ANL A,#0FH
	CALL BCD7
	MOV P0,A
	CJNE CHE_DO,#5,HT27
	JNB BITCT,HT28
	HT27:
	MOV P1,#11110111B ;XUAT MA QUET LET HANG CHUC GIO
	HT28:
	CALL TRELED
	MOV P1,#0FFH

	MOV A,NAM
	SWAP A
	ANL A,#0FH
	CALL BCD7
	MOV P0,A
	CJNE CHE_DO,#6,HT29
	JNB BITCT,HT210
	HT29:
	MOV P1,#11101111B ;XUAT MA QUET LET HANG CHUC GIO
	HT210:
	CALL TRELED
	MOV P1,#0FFH

	MOV A,NAM
	ANL A,#0FH
	CALL BCD7
	MOV P0,A
	CJNE CHE_DO,#6,HT211
	JNB BITCT,HT212
	HT211:
	MOV P1,#11011111B ;XUAT MA QUET LET HANG CHUC GIO
	HT212:
	CALL TRELED
	MOV P1,#0FFH
	RET
;===============================
BCD7: ;DOI MA BCD SANG MA 7 DOAN 
	MOV DPTR,#MA7DOAN
	MOVC A,@A+DPTR
	RET
MA7DOAN: ;BANG MA 7 DOAN
	DB 0C0H,0F9H,0A4H,0B0H,99H
	;   0    1    2    3    4 
	DB 92H,82H,0F8H,80H,90H,0FFH 
	;   5   6   7    8   9 
	DB 0C6H
	;	C 
;================================
;=======================	
TRELED:	;TAO TRE CHO LED KHI QUET
	PUSH 0
	PUSH 1
	MOV R1,#2
TL:
	MOV R0,#250
	DJNZ R0,$
	DJNZ R1,TL ; uS
	POP 1
	POP 0
	RET
;======================================== 	
NAPBT: ;NAP THOI GIAN BAO THUC
	PUSH ACC
	CALL START_BIT
	MOV A,#W1307
	CALL SENT_BYTE
	MOV	A,#8 ;NAP VAO RTC BAT DAU TU BYTE THU 8
	CALL SENT_BYTE
	MOV A,PHUT_BT
	CALL SENT_BYTE
	MOV	A,GIO_BT
	CALL SENT_BYTE
	POP ACC
	RET
;===================	 
DOCBT:
	PUSH 4
	MOV	R4,#8
	CALL DOCBYTE
	MOV	PHUT_BT,A

	
	POP 4
;======================================== 
DS1307INIT: ; KHOI DONG RTC; XOA BIT 7 BYTE
	PUSH ACC ; CAT TAM GIA TRI THANH GHI A VAO NGAN XEP
	PUSH B ; CAT TAM GIA TRI THANH GHI B VAO NGAN XEP
	CALL START_BIT ; TAO START BIT
	MOV  A,#W1307 ; NAP MA GHI DS1307
	CALL SENT_BYTE ; GHI VAO DS1307
   	MOV  A,#0 ; NAP DIA CHI 0 VAO DS1307
	CALL SENT_BYTE ; GHI VAO DS1307
;	CALL STOPB ; TAO STOP BIT
;--------------------------------------- 
	CALL START_BIT
	MOV  A,#R1307 ; NAP MA DOC DS1307
	CALL SENT_BYTE ; GHI VAO DS1307
	CALL RBYTE ; DOC BYET 0 TU DS1307 RA
	JNB ACC.7,EDS1307I ; THOAT KHOI DONG KHI BIT 7 DA DUOC XOA
	CLR  ACC.7 ; XOA BIT DAO DONG ( CHO PHEP TRC HOAT DONG )
	MOV  B,A ; CAT GIA TRI A VAO B
;	CALL STOPB ; TAO STOP BIT
;--------------------------------------- 
	CALL START_BIT
	MOV  A,#W1307
	CALL SENT_BYTE
	MOV	 A,#0
	CALL SENT_BYTE
	MOV  A,B
	CALL SENT_BYTE
EDS1307I:
	CALL STOP_BIT 
	POP B
	POP ACC
	RET
;======================================== 
;==================
NAPTG: ;NAP THOI GIAN VAO RTC
	CALL START_BIT	;GOI STATR BIT
	MOV A,#W1307 ;NAP CHE DO GHI VAO RTC
	CALL SENT_BYTE ;GHI BYTE VAO TRC
	MOV	A,#00H ;NAP DIA CHI VAO RTC
	CALL SENT_BYTE
	MOV A,GIAY ;NAP GIAY VAO RTC
	CALL SENT_BYTE ;GHI BYTE VAO TRC TU DONG TANG DIA CHI
	MOV	A,PHUT ;NAP PHUT VAO RCT
	CALL SENT_BYTE
	MOV	A,GIO
	CALL SENT_BYTE
	CALL STOP_BIT ;GOI STOP BIT
	RET
;==================
;CTC DOC CAC GIA TRI THOI GIAN
;============================
DOCTG: ;DOC THOI GIAN
	PUSH 4
	MOV	R4,#0 ;NAP DIA CHI 0
	CALL DOCBYTE ;DOC BYTE THEO DIA CHI
	MOV	GIAY,A 
	MOV	R4,#1
	CALL DOCBYTE
	MOV	PHUT,A
	MOV	R4,#2
	CALL DOCBYTE
 	MOV	GIO,A
	POP 4
	RET
;======================================== 
START_BIT: ; BIT START I2C
	SETB SDA
	SETB SCL
	CLR SDA
	CLR SCL
	RET
;======================================== 
STOP_BIT: ; BIT STOP I2C			   	
	CLR	SDA
	SETB SCL
	NOP
	SETB SDA
	RET
SENT_BYTE: ; GHI 1 BYTE DU LIEU
	PUSH 0 ;CAT TAM THOI GIA TRI THANH GHI R0 VAO NGAN XEP 
	RLC A
	MOV R0,#8 ;NAP SO LAN LAP 8 LAN
SB0:
	CLR SCL	
	MOV SDA,C
	NOP
	SETB SCL ;DUA CHAN SCL LEN MUC CAO 
	CLR SCL
	RLC A
	DJNZ R0,SB0
	SETB SDA
	SETB SCL
	CLR SCL
	POP 0 ;LAY GIA TRI CHO THANH GHI R0 TU NGAN XEP 
	RET
;======================================== 
RBYTE: ; DOC 1 BYTE DU LIEU
	PUSH 7				 	
	MOV R7,#8
RB:
	SETB SCL
	MOV C,SDA
	CLR SCL
	RLC A
	DJNZ R7,RB
	SETB SDA
	SETB SCL
	CLR	SCL
	POP 7
	RET
;=======================
DOCBYTE: ; DOC 1 BYTE TU DS1307
	CALL START_BIT
	MOV	 A,#W1307
	CALL SENT_BYTE
	MOV	 A,R4
	CALL SENT_BYTE
	CALL START_BIT
	MOV A,#R1307
	CALL SENT_BYTE
	CALL RBYTE
	CALL STOP_BIT
	RET
;====================
   	END
