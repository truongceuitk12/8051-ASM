	GIO EQU 7FH ;GIAY
	PHUT EQU 7EH ;PHUT
	GIAY EQU 7DH ;GIO

	PHUT_BT EQU 22H	; PHUT BAO THUC
	GIO_BT EQU 23H ; GIO BAO THUC
	
	SCL BIT P3.6 ;CHAN SCL NOI DEN ROM
	SDA BIT P3.7 ;CHAN SDA NOI DEN ROM					 

	W1307 EQU 0D0H ;HANG SO VIET VAO DS1307
	R1307 EQU 0D1H ;HANG S0 DOC	TU DS1307

	CHON BIT P2.0 ; NUT NHAN GHON GIA TRI CAN CHINH
	TANG  BIT P2.1 ; NUT NHAN TANG GIA TRI
	GIAM BIT P2.2 ; NUT NHAN GIAM GIA TRI
	CHON_BT BIT P2.3 ; NUT CHON CHINH BAO THUC
	TAT_BT BIT P2.4 ; NUT NHAN TAT BAO THUC

	COI BIT P3.0 ; COI BAO THUC

	PN BIT 20H.0 ; BIT NHO CO PHIM NHAN
	BITCT BIT 20H.1; BIT SU DUNG CHO CHUONG TRINH TAO CHOP TAT KHI CHINH
	CHOPTAT EQU R4 ; THOI GIAN CHO MOI LAN CHOP TAT KHI CHINH
	CHE_DO EQU R5 ; CHE DO HIEN THI VA CHIN THOI GIAN

	ORG 0 ;DIEM NHAP CUA RESET
;======================================== 
MAIN: ;CHUONG TRINH CHINH
	MOV SP,#30H ; NAP VI TRI NGAN XEP BAT DAU TU 30H
	MOV CHOPTAT,#100 ; 
	MOV CHE_DO,#0
	CALL DS1307INIT ;KHOI DONG RTC
	CALL DOCBT
MAIN1: 
	CALL DOC_TG ;DOC THOI GIAN TU RTC
	MOV R7,#100
LAP:
	CALL HIENTHI ;HIEN THI QUET LED 7 DOAN
	CALL QUET_PHIM_NHAN ;GOI CHUONG TRINH NUT NHAN CHINH THOI GIAN
	CALL DAO_BIT_CHOP_TAT
	CALL SO_SANH
	DJNZ R7,LAP
	SJMP  MAIN1 ;LAP LAI CHUONG TRINH
;====================
;====================
SO_SANH: ;CTC SO SANH DE BAO THUC
	PUSH ACC ; CAT TAM GIA TRI THANH GHI A VAO NGAN XEP 
	MOV A,GIAY
	CJNE A,#0,TSS
	MOV A,PHUT
	CJNE A,PHUT_BT,SS1
	MOV A,GIO
	CJNE A,GIO_BT,SS1
	CLR COI ; BAT COI
	RET ; TROAT KHOI CHUONG TRINH CON 
SS1:
	SETB COI ; TAT COI
TSS:
	POP ACC ; LAY LAI GIA TRI CHO THANH GHI A TU NGAN XEP 
	RET ; TROAT KHOI CHUONG TRINH CON 
;======================================== 
QUET_PHIM_NHAN: ; QUET NUT NHAN
	PUSH ACC ; CAT TAM GIA TRI THANH GHI A VAO NGAN XEP 
	JNB PN,NKN ; KIEM TRA KHONG NHAN NUT KHI PN = 0
		JB CHON,NN0 ; KIEM TRA NHAN PHIM CHON
			MOV CHOPTAT,#100 ; SO LAN QUET CHOP TAT = 100
			CLR BITCT ; TAT LED CHON KHI MOI NHAN
			CLR PN ; XOA PN = 0 ; CO PHIM NHAN
			INC CHE_DO ; TANG CHE DO
			CJNE CHE_DO,#4,TQPN ; NEU CHE DO = 3
			MOV CHE_DO,#0 ; NAP LAI CHE DO = 0
		JMP TQPN
	NN0:
		JB TANG,NN1
			MOV CHOPTAT,#100
			SETB BITCT ; HIEN THI LED CHON KHI MOI NHAN
			CLR PN
			CALL TANGTG; TANG GIA TRI DUOC CHON
			CALL NAPTG
		JMP TQPN
	NN1:
		JB GIAM,NN2
			MOV CHOPTAT,#100
			SETB BITCT
			CLR PN
			CALL GIAMTG	
			CALL NAPTG
		JMP TQPN
	NN2:
		JB CHON_BT,NN3
			MOV CHOPTAT,#100
			SETB BITCT ; HIEN THI LED CHON KHI MOI NHAN
			CLR PN
			MOV A,CHE_DO ; NAP A GIA TRI CHE DO
			CJNE A,#4,$+3
			JNC NN21 ; KHI A >= 4
			MOV CHE_DO,#4
			JMP NN22
		NN21: ; 
			INC CHE_DO
			CJNE CHE_DO,#6,NN22
			MOV CHE_DO,#0 
			CALL NAPBT
		NN22:
		JMP TQPN
	NN3:
	JB TAT_BT,TQPN
	SETB COI
	JMP TQPN
NKN: ; KIEM TRA NUT KHONG NHAN
	JNB CHON,TQPN ; KHI TAT CA CAC PHIM DUOC NHA
	JNB CHON_BT,TQPN
	JNB GIAM,TQPN
	JNB TANG,TQPN
	SETB PN	; PN = 1 ; CHO PHEP NHAN PHIM TIEPP THEO
TQPN:
	POP ACC ; LAY LAI GIA TRI CHO THANH GHI A TU NGAN XEP 
	RET ; TROAT KHOI CHUONG TRINH CON 
;======================================== 
TANGTG:	;CHUONG TRINH CON TANG THOI GIAN THEO MO
	PUSH ACC ; CAT TAM GIA TRI THANH GHI A VAO NGAN XEP 
	SETB BITCT
;--------------------
TGIAY: ;TANG GIAY
	CJNE CHE_DO,#1,TP
	MOV A,GIAY
	ADD A,#1 ;CONG THANH GHI A THEM 1
	DA A ;HIEU CHINH THAP PHAN THANH GHI A
	CJNE A,#60H,TGIAY1
	MOV A,#00H ;GIOI HAN 00 - 59
TGIAY1:
	MOV GIAY,A
	CALL NAPTG ;NAP GIAY VUA CHINH DUOC VAO RTC
;--------------------
TP: ; TANG PHUT
	CJNE CHE_DO,#2,TG
	MOV A,PHUT
	ADD A,#1
	DA A
	CJNE A,#60H,TP1
	MOV A,#00H ;GIOI HAN 00 - 59
TP1:
	MOV PHUT,A
;--------------------
TG: ; TANG GIO
	CJNE CHE_DO,#3,T_PHUT_BT
	MOV A,GIO
	ADD A,#1
	DA A
	CJNE A,#24H,TG3
	MOV A,#00H ;GIOI HAN 00 - 23
TG3:
	MOV GIO,A
;--------------------
T_PHUT_BT: ; TANG PHUT BAO THUC
	CJNE CHE_DO,#4,T_GIO_BT
	MOV A,PHUT_BT
	ADD A,#1
	DA A
	CJNE A,#60H,TAP
	MOV	A,#00H
TAP:
	MOV	PHUT_BT,A
;--------------------
T_GIO_BT: ; TANG GIO BAO THUC
	CJNE CHE_DO,#5,TT
	MOV A,GIO_BT
	ADD A,#1
	DA A
	CJNE A,#24H,TAG
	MOV A,#00H
TAG:
	MOV GIO_BT,A
TT:	
	POP ACC ; LAY LAI GIA TRI CHO THANH GHI A TU NGAN XEP 
	RET ; TROAT KHOI CHUONG TRINH CON 
;======================================== 
GIAMTG: ;GIAM THOI GIAN
	PUSH ACC ; CAT TAM GIA TRI THANH GHI A VAO NGAN XEP 
	SETB BITCT ;BAT BIT TAO CHOP TAT ( CHO HIEN THI KHI MOI NHAN NUT )
;--------------------
GGIAY: ; GIAM GIAY
	CJNE CHE_DO,#1,GP
	MOV A,GIAY
	ADD A,#99H
	DA A
	CJNE A,#99H,GGIAY1
	MOV A,#59H
GGIAY1:
	MOV	GIAY,A
	CALL NAPTG
;--------------------
GP: ; GIAM PHUT
	CJNE CHE_DO,#2,GG
	MOV A,PHUT
	ADD A,#99H
	DA A
	CJNE A,#99H,GP1
	MOV A,#59H
GP1:
	MOV	PHUT,A
;--------------------
GG: ; GIAM GIO
	CJNE CHE_DO,#3,G_PHUT_BT
	MOV A,GIO
	ADD A,#99H
	DA A
	CJNE A,#99H,TG6
	MOV A,#23H
TG6:
	MOV	GIO,A
;--------------------
G_PHUT_BT: ; GIAM PHUT BAO THUC
	CJNE CHE_DO,#4,G_GIO_BT
	MOV A,PHUT_BT
	ADD A,#99H
	DA A
	CJNE A,#99H,GAP
	MOV	A,#59H
GAP:
	MOV	PHUT_BT,A
;--------------------
G_GIO_BT: ; GIAM GIO BAO THUC
	CJNE CHE_DO,#5,TGTG
	MOV A,GIO_BT
	ADD A,#99H
	DA A
	CJNE A,#99H,GAG
	MOV A,#23H
GAG:
	MOV GIO_BT,A
;--------------------
TGTG: ;THOAT GIAM THOI GIAN
	POP ACC ; LAY LAI GIA TRI CHO THANH GHI A TU NGAN XEP
	RET ; TROAT KHOI CHUONG TRINH CON 
;======================================== 
DAO_BIT_CHOP_TAT:
	CJNE CHE_DO,#0,DBCT1
	JMP TDBCT
DBCT1:
	DJNZ CHOPTAT,TDBCT
	MOV CHOPTAT,#100
	CPL BITCT
TDBCT:
	RET ; TROAT KHOI CHUONG TRINH CON 
;======================================== 
;QUET HIEN THI LAN LUOT TUNG LED 7 DOAN
;TAI 1 THOI DIEM CHI SANG 1 LED
;==========================
HIENTHI:
	PUSH ACC ; CAT TAM GIA TRI THANH GHI A VAO NGAN XEP 
	MOV A,CHE_DO ; NAP A GIA TRI CHE DO
	CJNE A,#4,$+3 ; SO SANH A VOI 4
	JNC HT0; KHI A >= 4
	JNB TAT_BT,HT0
	CALL HIEN_THI_1	; KHI A < 4, GOI HIEN THI THOI GIAN
	JMP THT0 
HT0: ; 
	CALL HIEN_THI_2 ; KHI A > 4, GOI HIEN THI THOI GIAN BAO THUC
THT0:
	POP ACC ; LAY LAI GIA TRI CHO THANH GHI A TU NGAN XEP 
	RET ; TROAT KHOI CHUONG TRINH CON 
;======================================== 
HIEN_THI_1:
	MOV A,GIO ;NAP GIO VAO A 
	SWAP A ;HOAN DOI CAO THAP THANH GHI A
	ANL A,#0FH ;XOA BO 4 BIT CAO
	CALL BCD7 ;DOI MA BCD SANG MA 7 DOAN
	MOV P0,A ;XUAT MA 7 DOAN RA PORT 0
	CJNE CHE_DO,#3,HT11
	JNB BITCT,HT12
HT11:
	MOV P1,#11111110B ;XUAT MA QUET LET HANG CHUC GIO
HT12:
	CALL TRELED ;TOA THOI GIAN TRE QUET LED
	MOV P1,#0FFH ;XOA PORT QUET LED
	
	MOV A,GIO
	ANL A,#0FH
	CALL BCD7
	MOV P0,A
	CJNE CHE_DO,#3,HT13
	JNB BITCT,HT14
HT13:
	MOV P1,#11111101B ;XUAT MA QUET LET HANG CHUC GIO
HT14:
	CALL TRELED
	MOV P1,#0FFH

	MOV A,PHUT
	SWAP A
	ANL A,#0FH
	CALL BCD7
	MOV P0,A
	CJNE CHE_DO,#2,HT15
	JNB BITCT,HT16
HT15:
	MOV P1,#11111011B ;XUAT MA QUET LET HANG CHUC GIO
HT16:
	CALL TRELED
	MOV P1,#0FFH

	MOV A,PHUT
	ANL A,#0FH
	CALL BCD7
	MOV P0,A
	CJNE CHE_DO,#2,HT17
	JNB BITCT,HT18
HT17:
	MOV P1,#11110111B ;XUAT MA QUET LET HANG CHUC GIO
HT18:
	CALL TRELED
	MOV P1,#0FFH

	MOV A,GIAY
	SWAP A
	ANL A,#0FH
	CALL BCD7
	MOV P0,A
	CJNE CHE_DO,#1,HT19
	JNB BITCT,HT110
HT19:
	MOV P1,#11101111B ;XUAT MA QUET LET HANG CHUC GIO
HT110:
	CALL TRELED
	MOV P1,#0FFH

	MOV A,GIAY
	ANL A,#0FH
	CALL BCD7
	MOV P0,A
	CJNE CHE_DO,#1,HT111
	JNB BITCT,HT112
HT111:
	MOV P1,#11011111B ;XUAT MA QUET LET HANG CHUC GIO
HT112:
	CALL TRELED
	MOV P1,#0FFH
	RET ; TROAT KHOI CHUONG TRINH CON 
;======================================== 
HIEN_THI_2: ; HIEN THI GIO PHUT BAO THUC
	MOV A,GIO_BT ; NAP GIO BAO THUC VAO A 
	SWAP A ; HOAN DOI CAO THAP THANH GHI A
	ANL A,#0FH ; XOA BO 4 BIT CAO
	CALL BCD7 ; DOI MA BCD SANG MA 7 DOAN
	MOV P0,A ; XUAT MA 7 DOAN RA PORT 0
	CJNE CHE_DO,#5,HT21 ; KHI CHE DO = 5 VA KHI BIT CHOP TAT = 0 TAT LED
	JNB BITCT,HT22
HT21:
	MOV P1,#11111110B ;XUAT MA QUET LET HANG CHUC GIO
HT22:
	CALL TRELED ;TOA THOI GIAN TRE QUET LED
	MOV P1,#0FFH ;XOA PORT QUET LED
	
	MOV A,GIO_BT
	ANL A,#0FH
	CALL BCD7
	MOV P0,A
	CJNE CHE_DO,#5,HT23
	JNB BITCT,HT24
HT23:
	MOV P1,#11111101B ;XUAT MA QUET LET HANG CHUC GIO
HT24:
	CALL TRELED
	MOV P1,#0FFH

	MOV A,PHUT_BT
	SWAP A
	ANL A,#0FH
	CALL BCD7
	MOV P0,A
	CJNE CHE_DO,#4,HT25
	JNB BITCT,HT26
HT25:
	MOV P1,#11111011B ;XUAT MA QUET LET HANG CHUC GIO
HT26:
	CALL TRELED
	MOV P1,#0FFH

	MOV A,PHUT_BT
	ANL A,#0FH
	CALL BCD7
	MOV P0,A
	CJNE CHE_DO,#4,HT27
	JNB BITCT,HT28
HT27:
	MOV P1,#11110111B ;XUAT MA QUET LET HANG CHUC GIO
HT28:
	CALL TRELED
	MOV P1,#0FFH

	CALL TRELED
	CALL TRELED
	RET ; TROAT KHOI CHUONG TRINH CON 
;===============================
BCD7: ;DOI MA BCD SANG MA 7 DOAN 
	MOV DPTR,#MA7DOAN ; NAP CON TRO DU LIEU VI TRI MA 7 DOAN
	MOVC A,@A+DPTR ; LAY MA 7 DOAN THEO VI TRI
	RET ; TROAT KHOI CHUONG TRINH CON 
MA7DOAN: ;BANG MA 7 DOAN
	DB 0C0H,0F9H,0A4H,0B0H,99H
	;   0    1    2    3    4 
	DB 92H,82H,0F8H,80H,90H,0FFH 
	;   5   6   7    8   9 
	DB 0C6H
	;	C 
;================================	
TRELED:	;TAO TRE CHO LED KHI QUET 1MS
	PUSH 0 ; CAT TAM GIA TRI THANH GHI R0 VAO NGAN XEP 
	PUSH 1 ; CAT TAM GIA TRI THANH GHI R1 VAO NGAN XEP 
	MOV R1,#2 ; NAP R1 GIA TRI 2
TL:
	MOV R0,#250
	DJNZ R0,$ ; 250 X 2 US
	DJNZ R1,TL ; uS
	POP 1 ; LAY LAI GIA TRI CHO THANH GHI R1 TU NGAN XEP  
	POP 0 ; LAY LAI GIA TRI CHO THANH GHI R0 TU NGAN XEP  
	RET ; TROAT KHOI CHUONG TRINH CON 
;======================================== 
ACK BIT 20H.7 ; BIT THUA NHAN
;======================================== 	
NAPBT: ; NAP THOI GIAN BAO THUC
	PUSH ACC ; CAT TAM GIA TRI THANH GHI A VAO NGAN XEP 
	POP B ; LAY LAI GIA TRI CHO THANH GHI B TU NGAN XEP 
	CALL START_BIT ; TAO START BIT
	MOV A,#W1307 ; NAP MA GHI VAO DS
	CALL SENT_BYTE ; GHI VAO DS
	MOV	A,#8 ;NAP VAO RTC BAT DAU TU BYTE THU 8
	CALL SENT_BYTE ; GHI DIA CHI VAO DS
	MOV A,PHUT_BT ; NAP PHUT BAO THUC
	CALL SENT_BYTE ; GHI VAO DS
	MOV	A,GIO_BT ; NAP GIO BAO THUC
	CALL SENT_BYTE ; GHI VAO DS
	CALL STOP_BIT ; STOP BIT
	POP ACC ; LAY LAI GIA TRI THANH GHI
	RET ; TRO LAI DOAN CHUONG TRINH GOI NO
;===================	 
DOCBT:
	CALL START_BIT
	MOV	A,#W1307
	CALL SENT_BYTE
	MOV	A,#8
	CALL SENT_BYTE
	CALL START_BIT
	MOV A,#R1307
	CALL SENT_BYTE
	CLR ACK
	CALL READ_BYTE
	MOV PHUT_BT,A
	SETB ACK
	CALL READ_BYTE
	MOV GIO_BT,A
	CALL STOP_BIT ; STOP BIT
	RET ; TRO LAI DOAN CHUONG TRINH GOI NO
;======================================== 
DS1307INIT: ; KHOI DONG RTC; XOA BIT 7 BYTE
	PUSH ACC ; CAT TAM GIA TRI THANH GHI A VAO NGAN XEP
	PUSH B ; CAT TAM GIA TRI THANH GHI B VAO NGAN XEP
	CALL START_BIT ; TAO START BIT
	MOV  A,#W1307 ; NAP MA GHI DS1307
	CALL SENT_BYTE ; GHI VAO DS1307
   	MOV  A,#0 ; NAP DIA CHI 0 VAO DS1307
	CALL SENT_BYTE ; GHI VAO DS1307
;--------------------------------------- 
	CALL START_BIT
	MOV  A,#R1307 ; NAP MA DOC DS1307
	CALL SENT_BYTE ; GHI VAO DS1307
	SETB ACK
	CALL READ_BYTE ; DOC BYET 0 TU DS1307 RA
	JNB ACC.7,EDS1307I ; THOAT KHOI DONG KHI BIT 7 DA DUOC XOA
	CLR  ACC.7 ; XOA BIT DAO DONG ( CHO PHEP TRC HOAT DONG )
	MOV  B,A ; CAT GIA TRI A VAO B
;--------------------------------------- 
	CALL START_BIT
	MOV  A,#W1307
	CALL SENT_BYTE
	MOV	 A,#0
	CALL SENT_BYTE
	MOV  A,B
	CALL SENT_BYTE
EDS1307I:
	CALL STOP_BIT 
	POP B ; LAY LAI GIA TRI CHO THANH GHI B TU NGAN XEP 
	POP ACC ; LAY LAI GIA TRI CHO THANH GHI A TU NGAN XEP 
	RET ; TROAT KHOI CHUONG TRINH CON 
;======================================== 
NAPTG: ;NAP THOI GIAN VAO RTC
	CALL START_BIT ; STATR BIT
	MOV A,#W1307 ; NAP CHE DO GHI VAO RTC
	CALL SENT_BYTE ;GHI BYTE VAO TRC
	MOV	A,#0 ;NAP DIA CHI VAO RTC
	CALL SENT_BYTE
	MOV A,GIAY ;NAP GIAY VAO RTC
	CALL SENT_BYTE ;GHI BYTE VAO TRC TU DONG TANG DIA CHI
	MOV	A,PHUT ;NAP PHUT VAO RCT
	CALL SENT_BYTE
	MOV	A,GIO
	CALL SENT_BYTE
	CALL STOP_BIT ;GOI STOP BIT
	RET ; TROAT KHOI CHUONG TRINH CON 
;======================================== 
DOC_TG: ;DOC THOI GIAN
	CALL START_BIT ; STATR BIT
	MOV	A,#W1307 ; NAP CHE DO GHI VAO RTC
	CALL SENT_BYTE
	MOV	A,#0
	CALL SENT_BYTE
	CALL START_BIT
	MOV A,#R1307
	CALL SENT_BYTE
	CLR ACK
	CALL READ_BYTE
	MOV GIAY,A
	CALL READ_BYTE
	MOV PHUT,A
	SETB ACK
	CALL READ_BYTE
	MOV GIO,A
	CALL STOP_BIT
	RET ; TROAT KHOI CHUONG TRINH CON 
;======================================== 
START_BIT: ; BIT START I2C
	SETB SDA ; DUA SDA LEN MUC CAO
	SETB SCL ;DUA CHAN SCL LEN MUC CAO
	NOP
	CLR SDA ; DUA SDA XUONG THAP
	CLR SCL ; DUA SCL XUONG THAP
	RET ; TROAT KHOI CHUONG TRINH CON 
;======================================== 
STOP_BIT: ; BIT STOP I2C			   	
	CLR	SDA	; DUA SDA XUONG THAP
	SETB SCL ; DUA CHAN SCL LEN MUC CAO
	NOP
	SETB SDA ; DUA SDA LEN MUC CAO
	RET ; TROAT KHOI CHUONG TRINH CON 
;========================================
ACK_BIT: ; DOC BIT THUA NHAN TU SLEVER
	SETB SDA ; DUA SDA LEN MUC CAO
	SETB SCL ; DUA CHAN SCL LEN MUC CAO
	NOP
	MOV C,SDA ; DOC BIT THUA NHAN
	MOV ACK,C ; NAP ACK BIT BIT THUA NHAN
	CLR	SCL ; DUA SCL XUONG THAP
	RET ; TROAT KHOI CHUONG TRINH CON 
;========================================
ACK_BIT_MASTER: ; TAO BIT THUA NHAN TU MASTER
	CLR SDA	; DUA SDA XUONG THAP
	SETB SCL ; DUA CHAN SCL LEN MUC CAO
	NOP
	CLR	SCL	; DUA SCL XUONG THAP
	SETB SDA ; DUA SDA LEN CAO
	RET ; TROAT KHOI CHUONG TRINH CON 
;========================================  
SENT_BYTE: ; GHI 1 BYTE DU LIEU
	PUSH 0 ; CAT TAM THOI GIA TRI THANH GHI R0 VAO NGAN XEP 
	MOV R0,#8 ; NAP SO LAN LAP 8 LAN
SB0:
	RLC A ; DICH TRAI CO CO C A, BIT CAO DUOC PHAT TRUOC
	MOV SDA,C ; PHAI BIT RA SDA
	SETB SCL ; DUA SCL LEN MUC CAO, TAO  XUNG NHIP
	NOP
	CLR SCL	; DUA SCL XUONG THAP
	DJNZ R0,SB0 ; LAP LAI DU 8 LAN
	CALL ACK_BIT ; DOC BIT THUA NHAN
	POP 0 ;LAY GIA TRI CHO THANH GHI R0 TU NGAN XEP 
	RET ; TRO VE CHUONG TRINH GOI NO
;======================================== 
READ_BYTE: ; DOC 1 BYTE DU LIEU
	PUSH 0 ; CAT TAM GIA TRI THANH GHI R0 VAO NGAN XEP				 	
	MOV R0,#8 ; NAP SO LAN LAP 8 LAN CHO 8 BIT
RB0:
	SETB SCL ; DUA CHAN SCL LEN MUC CAO
	MOV C,SDA ; DOC BIT TU CHAN SDA
	CLR SCL	; DUA SCL XUONG THAP
	RLC A ; DICH TRAI CO CO A, NHAN BYTE CAO TRUOC
	DJNZ R0,RB0 ; LAP LAI DU 8 BIT
	JB ACK,RB1 ; THUA NHAN TU MASTER HAY KHONG THUA NHAN
	CALL ACK_BIT_MASTER	; THUA NHAN TU MASTER KHI ACK = 0, DOC LIEN TIEP DU LIEU
	JMP RB2
RB1:
	CALL ACK_BIT ; KHONG THUA NHAN TU MASTER, KET THUC DOC
RB2:
	POP 0 ;LAY LAI GIA TRI CHO THANH GHI R0 TU NGAN XEP 
	RET
;====================

   	END
